## firmware/rx/main/Kconfig.projbuild
```kconfig
menu "CSI receiver"
    config RX_ID
        int "Receiver number (1 = RX1, 2 = RX2)"
        range 1 2
        default 1

    choice RX_LINK
        prompt "Link to the host"
        default RX_LINK_USB_JTAG
        config RX_LINK_USB_JTAG
            bool "Native USB (USB-Serial-JTAG)"
        config RX_LINK_UART
            bool "UART0 via the board's UART/COM port"
    endchoice

    config RX_UART_BAUD
        int "UART baud rate"
        depends on RX_LINK_UART
        default 2000000

    config RX_UART_TX_GPIO
        int "UART TX pin to the host (ESP32-S3 UART0 default: 43)"
        depends on RX_LINK_UART
        default 43

    config RX_UART_RX_GPIO
        int "UART RX pin from the host (ESP32-S3 UART0 default: 44)"
        depends on RX_LINK_UART
        default 44

    config RX_TX_MAC
        string "TX MAC to accept (AA:BB:CC:DD:EE:FF); empty = accept any csi_tx frame"
        default "20:9B:A9:68:F3:F0"

    config RX_CHANNEL
        int "Wi-Fi channel"
        default 11

    config RX_HT40
        bool "Listen at HT40 (secondary below); off = HT20"
        default y

    config RX_EXPECTED_RATE_HZ
        int "TX packet rate the TX was built with (for radio_id check)"
        default 200

    config RX_LED_GPIO
        int "WS2812 RGB LED GPIO"
        default 48
endmenu
```

## firmware/tx/main/Kconfig.projbuild
```kconfig
menu "CSI transmitter"
    config TX_CHANNEL
        int "Wi-Fi channel"
        range 5 13
        default 11
        help
            Primary channel. With HT40 the secondary channel is BELOW, so 5..13.

    config TX_HT40
        bool "Transmit HT40 (40 MHz); off = HT20"
        default y

    config TX_RATE_HZ
        int "Packets per second"
        range 10 1000
        default 200

    config TX_POWER_QDBM
        int "Start-up TX power in 0.25 dBm units (8 = 2 dBm, the minimum; 20 = 5 dBm, D-017)"
        range 8 80
        default 20

    config TX_LED_GPIO
        int "Status LED GPIO (NodeMCU-32 boards: usually 2)"
        default 2
endmenu
```

## tools/a0_antenna_check/main/Kconfig.projbuild
```kconfig
menu "A0 antenna check"
    config A0_LED_WS2812
        bool "Status LED is an addressable RGB LED (WS2812)"
        default n if IDF_TARGET_ESP32
        default y
        help
            S3 DevKit boards: RGB LED. Classic ESP32 NodeMCU boards: plain LED.

    config A0_LED_GPIO
        int "Status LED GPIO"
        default 2 if IDF_TARGET_ESP32
        default 48
        help
            NodeMCU-32 (classic ESP32): usually 2. ESP32-S3-DevKitC-1: 48 on
            v1.0 boards, 38 on v1.1 boards. YD-style S3 boards: 48.
endmenu
```
